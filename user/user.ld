/*
 * NikiOS — линкер-скрипт тестовой userspace-программы.
 *
 * Упрощённый по сравнению с linker.ld ядра: это одноразовый тест
 * ELF64-загрузчика, а не постоянный ABI, поэтому здесь нет отдельных
 * PHDRS под R/RW/RX (в отличие от ядра) — elf64_loader.c всё равно
 * пока мапит все PT_LOAD-сегменты как RW+USER независимо от p_flags
 * (см. честное ограничение в include/elf64.h), так что раздельные
 * права здесь пока не дали бы практической разницы.
 */

ENTRY(_start)

SECTIONS
{
    . = 0x0000000000400000;

    .text : { *(.text) }
    .rodata : { *(.rodata) }
    .data : { *(.data) }
    .bss : { *(.bss) *(COMMON) }

    /DISCARD/ : { *(.comment) *(.eh_frame) *(.note.*) }
}
